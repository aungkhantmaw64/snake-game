## CMakeLists.txt
```
cmake_minimum_required(VERSION 3.20.0)

find_package(Zephyr REQUIRED HINTS $ENV{ZEPHYR_BASE})
project(snake-game)

target_sources(app PRIVATE src/main.c)
```

## Kconfig
```
menu "Snake Game Drivers"

rsource "drivers/Kconfig"

endmenu

menu "Zephyr Kernel"
source "Kconfig.zephyr"
endmenu

module = APPLICATION_MODULE
module-str = Application module
source "subsys/logging/Kconfig.template.log_config"
```

## prj.conf
```kconfig
CONFIG_PCD8544=y
```

## src/main.c
```c
/*
 * Copyright (c) 2012-2014 Wind River Systems, Inc.
 *
 * SPDX-License-Identifier: Apache-2.0
 */

#include <stdio.h>

#include "pcd8544.h"

int main(void) {
  printf("Hello World! %s\n", CONFIG_BOARD);
  return 0;
}
```
