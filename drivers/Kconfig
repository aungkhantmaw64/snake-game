## drivers/pcd8544/Kconfig
```kconfig
config PCD8544
    bool "PCD8544 LCD Driver"
    help
      This option enables pcd8544 lcd driver
```

## tests/drivers/pcd8544/testcase.yaml
```yaml
tests:
  # section.subsection
  drivers.pcd8544:
    build_only: false
    platform_allow:
      - nucleo_l152re
      - esp32_devkitc_wroom/esp32/procpu
    integration_platforms:
      - nucleo_l152re
      - esp32_devkitc_wroom/esp32/procpu
    tags: graphics
```
